## layers/meta-resin-digi/conf/layer.conf
```bitbake
BBPATH .= ":${LAYERDIR}"

BBFILES += "${LAYERDIR}/recipes-*/*/*.bb \
            ${LAYERDIR}/recipes-*/*/*.bbappend"

BBFILE_COLLECTIONS += "resin-digi"
BBFILE_PATTERN_resin-digi := "^${LAYERDIR}/"
BBFILE_PRIORITY_resin-digi = "1337"
```
